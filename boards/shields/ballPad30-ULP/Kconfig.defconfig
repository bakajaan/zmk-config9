## boards/shields/ballPad30-ULP/Kconfig.defconfig
```kconfig
if SHIELD_BALLPAD30-ULP_R

# Name must be less than 16 characters long!
config ZMK_KEYBOARD_NAME
    default "ballPad30-ULP"

config ZMK_SPLIT_ROLE_CENTRAL
    default y

endif

if SHIELD_BALLPAD30-ULP_R || SHIELD_BALLPAD30-ULP_L

config ZMK_SPLIT
    default y

endif
```

## boards/shields/ballPad30-ULP/Kconfig.shield
```kconfig
# No whitespace after the comma or in your part name!
config SHIELD_BALLPAD30-ULP-L
    def_bool $(shields_list_contains,ballPad30-ULP_L)

# No whitespace after the comma or in your part name!
config SHIELD_BALLPAD30-ULP-R
    def_bool $(shields_list_contains,ballPad30-ULP_R)
```
