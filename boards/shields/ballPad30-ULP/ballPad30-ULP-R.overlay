#include "ballPad30-ULP.dtsi" // The shared dtsi file is included in the overlay

&default_transform { // Offset of 3 because the left side has 3 columns
    col-offset = <5>;
};

// Label of the kscan node in the dtsi
&kscan0 {
    col-gpios
        = <&xiao_d 10 GPIO_ACTIVE_HIGH>
        , <&xiao_d 9 GPIO_ACTIVE_HIGH>
        , <&xiao_d 8 GPIO_ACTIVE_HIGH>
        , <&xiao_d 7 GPIO_ACTIVE_HIGH>
        , <&xiao_d 0 GPIO_ACTIVE_HIGH>
        ;
};
